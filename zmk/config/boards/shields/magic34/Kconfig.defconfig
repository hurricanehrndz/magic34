## zmk/config/boards/shields/magic34/Kconfig.defconfig
```kconfig
if SHIELD_MAGIC34_LEFT

config ZMK_KEYBOARD_NAME
	default "Magic34"

config ZMK_SPLIT_BLE_ROLE_CENTRAL
	default y

endif

if SHIELD_MAGIC34_LEFT || SHIELD_MAGIC34_RIGHT

config ZMK_SPLIT
	default y

endif
```

## zmk/config/boards/shields/magic34/Kconfig.shield
```kconfig
config SHIELD_MAGIC34_LEFT
	def_bool $(shields_list_contains,magic34_left)

config SHIELD_MAGIC34_RIGHT
	def_bool $(shields_list_contains,magic34_right)
```
